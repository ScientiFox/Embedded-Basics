/*
 Example script for putting text on the screen dynamically
*/
#include <inttypes.h>
#include <ctype.h>

// required libraries
#include <SPI.h>
#include <FLASH.h>
#include <EPD.h>
#include <S5813A.h>

//EPD setting variables
const int Pin_TEMPERATURE = A0;
const int Pin_PANEL_ON = 2;
const int Pin_BORDER = 3;
const int Pin_DISCHARGE = 4;
const int Pin_PWM = 5;
const int Pin_RESET = 6;
const int Pin_BUSY = 7;
const int Pin_EPD_CS = 8;
const int Pin_FLASH_CS = 9;
const int Pin_SW2 = 12;
const int Pin_RED_LED = 13;

// LED anode through resistor to I/O pin
// LED cathode to Ground
#define LED_ON  HIGH
#define LED_OFF LOW

//Set EPD model
#define EPD_SIZE EPD_1_44

// define the E-Ink display
EPD_Class EPD(EPD_SIZE, Pin_PANEL_ON, Pin_BORDER, Pin_DISCHARGE, Pin_PWM, Pin_RESET, Pin_BUSY, Pin_EPD_CS);

//Memory based character list register
static int char_set[] = {0x1c,0x3e,0xb8,0x3e,0x7e,0xfe,0xb8,0xee,0x7c,0xf8,0xce,0x1e,0xc3,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0x0,0x0};

// I/O setup
void setup() {
	//Init EPD control pins
	pinMode(Pin_RED_LED, OUTPUT);
	pinMode(Pin_SW2, INPUT);
	pinMode(Pin_TEMPERATURE, INPUT);
	pinMode(Pin_PWM, OUTPUT);
	pinMode(Pin_BUSY, INPUT);
	pinMode(Pin_RESET, OUTPUT);
	pinMode(Pin_PANEL_ON, OUTPUT);
	pinMode(Pin_DISCHARGE, OUTPUT);
	pinMode(Pin_BORDER, OUTPUT);
	pinMode(Pin_EPD_CS, OUTPUT);
	pinMode(Pin_FLASH_CS, OUTPUT);

	//Set control pins to initial values
	digitalWrite(Pin_RED_LED, LOW);
	digitalWrite(Pin_PWM, LOW);
	digitalWrite(Pin_RESET, LOW);
	digitalWrite(Pin_PANEL_ON, LOW);
	digitalWrite(Pin_DISCHARGE, LOW);
	digitalWrite(Pin_BORDER, LOW);
	digitalWrite(Pin_EPD_CS, LOW);
	digitalWrite(Pin_FLASH_CS, HIGH);

	Serial.begin(9600); //Start serial port

	//Activate flash chip
	FLASH.begin(Pin_FLASH_CS);
	if (FLASH.available()) {
		Serial.println("FLASH chip detected OK");
	} else {
		//Maunfacturer diagnostics
		uint8_t maufacturer;
		uint16_t device;
		FLASH.info(&maufacturer, &device);
		Serial.print("unsupported FLASH chip: MFG: 0x");
		Serial.print(maufacturer, HEX);
		Serial.print("  device: 0x");
		Serial.print(device, HEX);
		Serial.println();
	}

	// configure temperature sensor
	S5813A.begin(Pin_TEMPERATURE);
}

//State machine variables and line holder
static int state = 0;
int n = 0;
uint8_t lne[16];

//Looping letters for dynamic test
int z  = 0;

//Character map
int ch_map[8][16];

//Function to take letter from indexed map into the line being written
void write_letter(int cur_x, int L, int j){
    lne[cur_x] = char_set[j*25 + L];}

// main loop
void loop() {
	EPD.begin(); // power up the EPD panel
        EPD.clear(); //make sure it's clear

        while(1){ //do forever
          if (n == 16){ n = 0;} //Loop cycle for variables
          if (z == 8){z = 1;}

          //line 1
          for(int j = 0;j<12;j++){
            write_letter(0,7,j); //Write letters at intermittent positions
            write_letter(1,4,j);
            write_letter(2,11,j);
            write_letter(3,11,j);
            write_letter(4,14,j);
            EPD.line(j,lne,0,false,EPD_normal); //Write letters- doubled for higher contrast
            EPD.line(j,lne,0,false,EPD_normal);}
            
          //line 2
          for(int j = 0;j<12;j++){
            write_letter((0+n)%16,22,j); //Write different letters at intermittent positions
            write_letter((1+n)%16,14,j);
            write_letter((2+n)%16,17,j);
            write_letter((3+n)%16,11,j);
            write_letter((4+n)%16,3,j);
            EPD.line(j+12*z,lne,0,false,EPD_normal); //also doubled
            EPD.line(j+12*z,lne,0,false,EPD_normal);}
        
        //Increment loop variables
        n++;
        z++;
        delay(500); //2Hz update rate
        }
        EPD.end();   // power down the EPD panel
}
