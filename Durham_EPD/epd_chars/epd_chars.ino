// -*- mode: c++ -*-
#include <inttypes.h>
#include <ctype.h>
#include <avr/pgmspace.h>

// required libraries
#include <SPI.h>
#include <FLASH.h>
#include <EPD.h>
#include <S5813A.h>

const int Pin_TEMPERATURE = A0;
const int Pin_PANEL_ON = 2;
const int Pin_BORDER = 3;
const int Pin_DISCHARGE = 4;
const int Pin_PWM = 5;
const int Pin_RESET = 6;
const int Pin_BUSY = 7;
const int Pin_EPD_CS = 8;
const int Pin_FLASH_CS = 9;
const int Pin_SW2 = 12;
const int Pin_RED_LED = 13;

#define LED_ON  HIGH
#define LED_OFF LOW
#define EPD_SIZE EPD_1_44
EPD_Class EPD(EPD_SIZE, Pin_PANEL_ON, Pin_BORDER, Pin_DISCHARGE, Pin_PWM, Pin_RESET, Pin_BUSY, Pin_EPD_CS);


PROGMEM prog_uchar char_set[] = {0x1c,0x3e,0xb8,0x3e,0x7e,0xfe,0xb8,0xee,0x7c,0xf8,0xce,0x1e,0xc3,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0x0,0x0};

int n = 0;
uint8_t lne[16];
int ch_map[8][16];
int i,j,k;

void write_letter(int cur_x, int L, int t){
    lne[cur_x] = pgm_read_byte_near(char_set + t*25 + L);}

void write_line(int cur_x, int cur_y, String text){
  for (n=0;n<text.length();n++){
    ch_map[cur_y][cur_x] = text[n]-97;
    cur_x++;
    if (cur_x == 16){
      cur_x = 0;
      cur_y++;}
    if (cur_y == 8){
      cur_y = 0;}
  }
  //EPD_draw();
}

void EPD_draw(){
  for (i = 0; i< 8;i++){
    for(j = 0;j<12;j++){
      for (k = 0;k<16;k++){
        if (ch_map[i][k] != 26){
          write_letter(k,ch_map[i][k],j);}
        else{
          lne[k] = 0;}
        EPD.line(i*12+j,lne,0,false,EPD_normal);
      }}}
}

void clear_EPD(){    
  for (j = 0;j<8;j++){
    for (i=0;i<16;i++){
      ch_map[j][i] = 26;}}
}

void print_char_map(){
  for (i = 0;i<8;i++){
    for (j=0;j<16;j++){
      if (ch_map[i][j] != 26){
        Serial.print(char(97+ch_map[i][j]));}
      else{
        Serial.print("_");
      }
      //Serial.print(" ");
    }
    Serial.println();}
}

void setup() {
        clear_EPD();
	pinMode(Pin_RED_LED, OUTPUT);
	pinMode(Pin_SW2, INPUT);
	pinMode(Pin_TEMPERATURE, INPUT);
	pinMode(Pin_PWM, OUTPUT);
	pinMode(Pin_BUSY, INPUT);
	pinMode(Pin_RESET, OUTPUT);
	pinMode(Pin_PANEL_ON, OUTPUT);
	pinMode(Pin_DISCHARGE, OUTPUT);
	pinMode(Pin_BORDER, OUTPUT);
	pinMode(Pin_EPD_CS, OUTPUT);
	pinMode(Pin_FLASH_CS, OUTPUT);

	digitalWrite(Pin_RED_LED, LOW);
	digitalWrite(Pin_PWM, LOW);
	digitalWrite(Pin_RESET, LOW);
	digitalWrite(Pin_PANEL_ON, LOW);
	digitalWrite(Pin_DISCHARGE, LOW);
	digitalWrite(Pin_BORDER, LOW);
	digitalWrite(Pin_EPD_CS, LOW);
	digitalWrite(Pin_FLASH_CS, HIGH);
	Serial.begin(9600);
	FLASH.begin(Pin_FLASH_CS);
	if (FLASH.available()) {
		Serial.println("FLASH chip detected OK");} 
        else{
		uint8_t maufacturer;
		uint16_t device;
		FLASH.info(&maufacturer, &device);
		Serial.print("unsupported FLASH chip: MFG: 0x");
		Serial.print(maufacturer, HEX);
		Serial.print("  device: 0x");
		Serial.print(device, HEX);
		Serial.println();}
	S5813A.begin(Pin_TEMPERATURE);}

// main loop

void loop() {
  EPD.begin(); // power up the EPD panel
  EPD.clear();
  int z = 0;
  while(1){    
    write_line(0,0,"hello");
    write_line(1+z,2,"world");
    z+=1;
    z = z*(z < 30);
    //Serial.println(z);
    EPD_draw();
    print_char_map();
    clear_EPD();
    delay(1000);
        
  }
  EPD.end();   // power down the EPD panel
}

