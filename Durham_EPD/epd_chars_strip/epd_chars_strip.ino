/*
A foundational test to map characters on EPD
*/


//Required libs
#include <avr/pgmspace.h>
#include <SPI.h>
#include <FLASH.h>
#include <EPD.h>
#include <S5813A.h>

//definitions- #def saves SRAM
#define Pin_TEMPERATURE A0
#define Pin_PANEL_ON 2
#define Pin_BORDER 3
#define Pin_DISCHARGE 4
#define Pin_PWM 5
#define Pin_RESET 6
#define Pin_BUSY 7
#define Pin_EPD_CS 8
#define Pin_FLASH_CS 9
#define Pin_SW2 12
#define Pin_RED_LED 13
#define LED_ON  HIGH
#define LED_OFF LOW
#define EPD_SIZE EPD_1_44

//Base items- EPD&charset
EPD_Class EPD(EPD_SIZE, Pin_PANEL_ON, Pin_BORDER, Pin_DISCHARGE, Pin_PWM, Pin_RESET, Pin_BUSY, Pin_EPD_CS);
PROGMEM prog_uchar char_set[] = {0x1c,0x3e,0xb8,0x3e,0x7e,0xfe,0xb8,0xee,0x7c,0xf8,0xce,0x1e,0xc3,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0x0,0x0};

//Durham_EPD stuff- lbl,charmap,bitmap
uint8_t lne[16];
uint8_t ch_map[8][16];
uint8_t bmp[48][8];

//incrementors- globals prevent overuse problems
int n = 0;
int i,j,k;

//Function to write a letter by index from the progmem array
void write_letter(int cur_x, int L, int t){
    lne[cur_x] = pgm_read_byte_near(char_set + t*25 + L);}

//Function to write a line of text to the display
void write_line(int cur_x, int cur_y, String text){
  for (n=0;n<text.length();n++){ //Increment over string
    ch_map[cur_y][cur_x] = text[n]-97;
    cur_y = (cur_y + (cur_x==16))*((cur_y + (cur_x==16))< 8); //Indexing xy by mmio array
    cur_x = (cur_x<16)*(cur_x+1);
  }}

//Function to draw a character on screen
void EPD_draw(){
  for (i = 0; i< 8;i++){
    for(j = 0;j<12;j++){ //Looping over array
      for (k = 0;k<16;k++){ //looping over characters
        if (ch_map[i][k] != 26){write_letter(k,ch_map[i][k],j);} //Draw non null chars
        else{lne[k] = 0;} //Otherwise set the line element to null
        EPD.line(i*12+j,lne,0,false,EPD_normal); //epd function to write the line to screen
      }}}}

//FUnction to cleat the epd display
void clear_EPD(){    
  for (j = 0;j<8;j++){//loop over array
    for (i=0;i<16;i++){
     ch_map[j][i] = 26; //set to null
    }}}

//Function to print the EPD array to serial
void print_char_map(){
  for (i = 0;i<8;i++){ //loop over array
    for (j=0;j<16;j++){
      if (ch_map[i][j] != 26){ //if not null
        Serial.print(char(97+ch_map[i][j]));} //print to serial
      else{
        Serial.print("_");} //otherwise a placeholder space
    }
    Serial.println();
  }
}

void init_EPD(){
  //Initialize the display
  
  //Set the control pin modes
  pinMode(Pin_RED_LED, OUTPUT);
  pinMode(Pin_SW2, INPUT);
  pinMode(Pin_TEMPERATURE, INPUT);
  pinMode(Pin_PWM, OUTPUT);
  pinMode(Pin_BUSY, INPUT);
  pinMode(Pin_RESET, OUTPUT);
  pinMode(Pin_PANEL_ON, OUTPUT);
  pinMode(Pin_DISCHARGE, OUTPUT);
  pinMode(Pin_BORDER, OUTPUT);
  pinMode(Pin_EPD_CS, OUTPUT);
  pinMode(Pin_FLASH_CS, OUTPUT);

  //Start up the control pins to init values
  digitalWrite(Pin_RED_LED, LOW);
  digitalWrite(Pin_PWM, LOW);
  digitalWrite(Pin_RESET, LOW);
  digitalWrite(Pin_PANEL_ON, LOW);
  digitalWrite(Pin_DISCHARGE, LOW);
  digitalWrite(Pin_BORDER, LOW);
  digitalWrite(Pin_EPD_CS, LOW);
  digitalWrite(Pin_FLASH_CS, HIGH);

  Serial.begin(9600); //Init serial port

  FLASH.begin(Pin_FLASH_CS); //activate the flash chip
  if (FLASH.available()) {Serial.println("FLASH chip detected OK");} 
  else{Serial.println("Problem with FLASH chip");}

  //start the S5813A controller
  S5813A.begin(Pin_TEMPERATURE);
  
}

void setup() {
  init_EPD(); //Initialize the EPD
  clear_EPD(); //Make sure ram is cleared  
}

void loop() {
  EPD.begin(); // power up the EPD panel
  EPD.clear(); // ensure Ram is clear each loop

  int z = 0; //demo counter
  while(1){
    //Write demo text
    write_line(0,0,"hello");
    write_line(1,2+z,"world"); //counter for dynamic demo
    write_line(7,4,"wop");
    write_line(9,6,"wap");
    z+=1;
    z = z*(z < 7) + 2*(z == 7); //Just a loop

    //Serial.println(z); //To verify z, if you want

    EPD_draw(); //Draw to the screen
    print_char_map(); //SHow what was drawn on serial
    clear_EPD(); //Clear screen
    delay(1000); //update once per second
  }
  EPD.end();   // power down the EPD panel
}

